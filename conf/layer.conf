## conf/layer.conf
```bitbake
# We have a conf and classes directory, add to BBPATH
BBPATH .= ":${LAYERDIR}"

# We have recipes-* directories, add to BBFILES
BBFILES += "${LAYERDIR}/recipes-*/*/*.bb \
            ${LAYERDIR}/recipes-*/*/*.bbappend"

BBFILE_COLLECTIONS += "meta-einfochips"
BBFILE_PATTERN_meta-einfochips = "^${LAYERDIR}/"
BBFILE_PRIORITY_meta-einfochips = "9"

LAYERDEPENDS_meta-einfochips = "core"
LAYERSERIES_COMPAT_meta-einfochips = "zeus hardknott"
```

## conf/machine/imx8mqthor96.conf
```bitbake
#@TYPE: Machine
#@NAME: NXP i.MX8MQ Thor96
#@SOC: i.MX8MQ
#@DESCRIPTION: Machine configuration for NXP i.MX8MQ Thor96
#@MAINTAINER: Darshak Patel <darshak.patel@einfochips.com>

MACHINEOVERRIDES =. "mx8:mx8m:mx8mq:"

require conf/machine/include/imx-base.inc
require conf/machine/include/tune-cortexa53.inc

BOARD_TYPE = "thor96"
MACHINE_FEATURES += "pci wifi bluetooth"

MACHINE_FEATURES_append += " bcm43455 bcm4356 bcm4359 mrvl8997"
WKS_FILE_DEPENDS_append += " imx-m4-demos"
IMAGE_BOOT_FILES_append += " imx8mq_m4_TCM_hello_world.bin imx8mq_m4_TCM_rpmsg_lite_pingpong_rtos_linux_remote.bin imx8mq_m4_TCM_rpmsg_lite_str_echo_rtos.bin"

MACHINE_SOCARCH_FILTER_append_mx8mq = " virtual/libopenvg virtual/libgles1 virtual/libgles2 virtual/egl virtual/mesa virtual/libgl virtual/libg2d"

KERNEL_DEVICETREE = "\
    freescale/imx8mq-thor96.dtb \
    freescale/imx8mq-thor96-dual-display.dtb \
    freescale/imx8mq-thor96-dcss-rm67191.dtb \
    freescale/imx8mq-thor96-lcdif-adv7535.dtb \
    freescale/imx8mq-thor96-otg-host.dtb \
    freescale/imx8mq-thor96-ap1302-ar0430.dtb \
    freescale/imx8mq-thor96-ap1302-arx3a0.dtb \
    freescale/imx8mq-thor96-ap1302-ar1335.dtb \
    freescale/imx8mq-thor96-ap1302-ar0830.dtb \
"
UBOOT_CONFIG ??= "sd"
UBOOT_CONFIG[sd] = "imx8mq_thor96_config,sdcard"
UBOOT_CONFIG[mfgtool] = "imx8mq_thor96_config"
SPL_BINARY = "spl/u-boot-spl.bin"

# Set DDR FIRMWARE
DDR_FIRMWARE_NAME = "lpddr4_pmu_train_1d_imem.bin lpddr4_pmu_train_1d_dmem.bin lpddr4_pmu_train_2d_imem.bin lpddr4_pmu_train_2d_dmem.bin"

# Set u-boot DTB
UBOOT_DTB_NAME = "imx8mq-thor96.dtb"

SOC = "iMX8MQ"
IMX_BOOT_SOC_TARGET = "iMX8MQ"

# Set imx-mkimage boot target
IMXBOOT_TARGETS = "flash_evk flash_evk_no_hdmi flash_dp_evk"

# Set Serial console
SERIAL_CONSOLES = "115200;ttymxc0"

IMAGE_BOOTLOADER = "imx-boot"

LOADADDR = ""
UBOOT_SUFFIX = "bin"
UBOOT_MAKE_TARGET = ""
IMX_BOOT_SEEK = "33"

OPTEE_BIN_EXT = "8mq"

# Add additional firmware
MACHINE_FIRMWARE_append = " linux-firmware-ath10k"

ATF_PLATFORM = "imx8mq"

# Use gstreamer 1.14 from meta-freescale
PREFERRED_VERSION_gstreamer1.0 ?= "1.14.imx"
PREFERRED_VERSION_gstreamer1.0-plugins-base ?= "1.14.imx"
PREFERRED_VERSION_gstreamer1.0-plugins-good ?= "1.14.imx"
PREFERRED_VERSION_gstreamer1.0-plugins-bad ?= "1.14.imx"
PREFERRED_VERSION_gstreamer1.0-libav ?= "1.14.0"

PACKAGECONFIG_append_pn-opencv_mx8 += " test"
IMAGE_ROOTFS_EXTRA_SPACE = "2000000"

PACKAGECONFIG_append_pn-qtbase += " sql-sqlite"
PACKAGECONFIG_remove += "kernel-pcitest wireless-regdb-static"

# meta-Einfochips
FORTRAN_forcevariable = ",fortran"

INSANE_SKIP_python3-dlib_append += " already-stripped"

FORTRAN_TOOLS = " \
                 gfortran \
                 gfortran-symlinks \
                 libgfortran \
                 libgfortran-dev \
                 "
PACKAGECONFIG_append_pn-opencv_mx8 = " python3 opencl dnn v4l qt5 jasper openmp test neon gstreamer tbb text png jpeg samples gphoto2 tiff "
TOOLCHAIN_HOST_TASK_append = " nativesdk-cmake nativesdk-make"

IMAGE_INSTALL_append += "arm-compute-library net-tools iputils dhcpcd which gzip git zlib patchelf nano tmux swig tar parted e2fsprogs e2fsprogs-resize2fs ppp wget curl iperf3 obexftp zip unzip cmake ${FORTRAN_TOOLS} python-core python-dev python3-dev python3-setuptools python-pip python3-pip python3-numpy python3-pandas portaudio-v19 opencv python3-opencv python3-cython python3-cycler python3-pyyaml python3-pillow python3-dlib python3-pyaudio python3-facerecog python3-speechrecognition hdf5 python3-h5py python3-pyqt5 python3-imutils ml-sdk python3-astor python3-termcolor python3-pkgconfig python3-keras-applications python3-keras-preprocessing python3-wheel python3-absl python3-gast python3-markdown python3-werkzeug python3-keras python3-kiwisolver coreutils htop gdb dnsmasq"

IMAGE_INSTALL_append += "i2c-tools dosfstools imx-test imx-gpu-viv-demos gputop opencv opencv-samples quectel-ppp chemicalplanthmi qtcharts videohmiapp thor-sdk packagegroup-core-buildessential apache2 zigbee v4l-utils iperf3 mosquitto qtmultimedia qtwebengine qtwebengine-examples alsa-dev alsa-lib alsa-lib-dev tensorflow-lite php-phar php-cgi php-fpm php-dev php-phpdbg php php-fpm-apache2"

# Add Chromium
IMAGE_INSTALL_append += \
                           "${@bb.utils.contains('DISTRO_FEATURES', 'wayland', ' chromium-ozone-wayland libexif', \
                                   bb.utils.contains('DISTRO_FEATURES',     'x11', ' chromium-x11 libexif', \
                                                                                                           '', d), d)}"
LICENSE_FLAGS_WHITELIST += \
                              "${@bb.utils.contains('DISTRO_FEATURES', 'wayland', 'commercial', \
                                      bb.utils.contains('DISTRO_FEATURES',     'x11', 'commercial', \
                                                                                                              '', d),"

EXTRA_IMAGE_FEATURES = " debug-tweaks tools-debug tools-sdk ssh-server-openssh"
IMAGE_ROOTFS_EXTRA_SPACE = "2000000"

#Changes for ap1302 interface
IMAGE_INSTALL_append += "ap1302-firmware \
			 thor96-root-files "
```

## conf/machine/imx8qxpaiml.conf
```bitbake
#@NAME: i.MX 8QXP AIML
#@DESCRIPTION: i.MX 8QXP AIML board
#@MAINTAINER:Darshak patel <darshak.patel@einfochips.com>

MACHINEOVERRIDES =. "mx8:mx8x:mx8qxp:"

require conf/machine/include/imx-base.inc
require conf/machine/include/tune-cortexa35.inc


# Don't include kernels in standard images
RDEPENDS_${KERNEL_PACKAGE_NAME}-base = ""

LOADADDR = ""

# We have to disable SERIAL_CONSOLE due to auto-serial-console
SERIAL_CONSOLES = "115200;ttyAMA0"

# we do not want to have getty running on tty1 as we run
# auto-serial-console there
USE_VT = "0"

KERNEL_DEVICETREE = " \
			freescale/imx8qxp-aiml-ei.dtb \
			freescale/imx8qxp-ai_ml.dtb \
			freescale/imx8qxp-aiml-ei-rpmsg.dtb  \
			freescale/imx8qxp-aiml-ei-dsi-rm67191.dtb \
			freescale/imx8qxp-aiml-ei-ov5640.dtb   \
		"

UBOOT_MAKE_TARGET = "u-boot.bin"
UBOOT_SUFFIX = "bin"
UBOOT_CONFIG ??= "sd"
UBOOT_CONFIG[sd] = "imx8qxp_aiml_ei_defconfig,sdcard"

IMAGE_BOOTLOADER = "imx-boot"
IMX_BOOT_SEEK = "32"

IMXBOOT_TARGETS = \
    "${@bb.utils.contains('UBOOT_CONFIG',   'sd', 'flash', \
        bb.utils.contains('UBOOT_CONFIG', 'fspi', 'flash_flexspi', \
                                                  'UNKNOWN', d), d)}"

BOARD_TYPE = "aiml"

# Add additional firmware
MACHINE_FIRMWARE_append = " linux-firmware-ath10k"

IMAGE_INSTALL_append += "lwb5-fcc-firmware"
IMAGE_INSTALL_append += "lwb-backports-laird"
IMAGE_INSTALL_append += "brcm-patchram-plus"
IMAGE_INSTALL_append += "quectel-ppp"
PACKAGECONFIG_append_pn-opencv_mx8 += " test"
IMAGE_ROOTFS_EXTRA_SPACE = "2000000"

MACHINE_FEATURES_remove = "optee"
PACKAGECONFIG_remove += " kernel-pcitest wireless-regdb-static"

# meta-Einfochips
FORTRAN_forcevariable = ",fortran"

INSANE_SKIP_python3-dlib_append += " already-stripped"

FORTRAN_TOOLS = " \
			gfortran \
			gfortran-symlinks \
			libgfortran \
			libgfortran-dev \
		"

PACKAGECONFIG_append_pn-opencv_mx8 = " python3 opencl dnn v4l qt5 jasper openmp test neon gstreamer tbb text png jpeg samples gphoto2 tiff "
TOOLCHAIN_HOST_TASK_append = " nativesdk-cmake nativesdk-make"

IMAGE_INSTALL_append += "arm-compute-library net-tools iputils dhcpcd which gzip git zlib patchelf nano tmux swig tar parted e2fsprogs e2fsprogs-resize2fs ppp wget curl iperf3 bluez-alsa obexftp zip unzip cmake ${FORTRAN_TOOLS} python-core python-dev python3-dev python3-setuptools python-pip python3-pip python3-numpy python3-pandas portaudio-v19 opencv python3-opencv python3-cython python3-cycler python3-pyyaml python3-pillow python3-dlib python3-pyaudio python3-facerecog python3-speechrecognition python3-scikitlearn hdf5 python3-h5py python3-pyqt5 python3-imutils ml-sdk python3-astor python3-termcolor python3-pkgconfig python3-keras-applications python3-keras-preprocessing python3-wheel python3-absl python3-gast python3-markdown python3-werkzeug python3-keras python3-kiwisolver coreutils htop gdb "

EXTRA_IMAGE_FEATURES = " debug-tweaks tools-debug tools-sdk ssh-server-openssh"
```
